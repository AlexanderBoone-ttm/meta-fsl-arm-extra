## conf/machine/txul-0011.conf
```bitbake
#@TYPE: Machine
#@NAME: Ka-Ro electronics TX6UL eMMC
#@SOC: i.MX6UL
#@DESCRIPTION: Machine configuration for Ka-Ro electronics TX6UL (i.MX6UL) Computer-On-Module with eMMC
#@MAINTAINER: Oliver Wendt <ow@karo-electronics.com>

require include/tx6ul-karo-common.inc

SOC_FAMILY = "mx6ul:txul"

UBOOT_MACHINE = "tx6ul-0011_defconfig"

PREFERRED_VERSION_linux-karo ?= "4.4%"
KERNEL_DEVICETREE = "imx6ul-tx6ul-0011.dtb"
```
